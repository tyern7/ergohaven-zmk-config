## config/west.yml
```yaml
manifest:
  remotes:
    - name: ergohaven
      url-base: https://github.com/ergohaven
    - name: zzeneg # <-- required for Raw HID module
      url-base: https://github.com/zzeneg
    - name: srwi # <-- required for KeyPeek module
      url-base: https://github.com/srwi
  projects:
    - name: ergohaven-zmk
      remote: ergohaven
      revision: main
      import: config/west.yml
    - name: zmk-raw-hid # <-- Raw HID module
      remote: zzeneg
      revision: main
    - name: zmk-keypeek-layer-notifier # <-- KeyPeek module
      remote: srwi
      revision: master
  self:
    path: config
```
